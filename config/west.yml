## config/west.yml
```yaml
manifest:
  remotes:
    - name: zmkfirmware
      url-base: https://github.com/zmkfirmware
    - name: urob
      url-base: https://github.com/urob
  projects:
    - name: zmk
      remote: zmkfirmware
      revision: v0.3  # Pin to stable version
      import: app/west.yml
    - name: zmk-adaptive-key
      remote: urob
      revision: v0.3  # Match ZMK version
  self:
    path: config
```
